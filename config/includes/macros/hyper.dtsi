/ {
  macros {
    hyp: hyper {
      compatible = "zmk,behavior-macro";
      #binding-cells = <0>;
      bindings
        = <&macro_press &kp LEFT_META>,
          <&macro_press &kp LEFT_CONTROL>,
          <&macro_press &kp LEFT_ALT>,
          <&macro_pause_for_release>,
          <&macro_release &kp LEFT_META>,
          <&macro_release &kp LEFT_CONTROL>,
          <&macro_release &kp LEFT_ALT>;
    };

    hypk: hyper_key {
      compatible = "zmk,behavior-macro-one-param";
      #binding-cells = <1>;
      bindings 
        = <&macro_press &hyp>,
          <&macro_param_1to1>,
          <&macro_tap &kp MACRO_PLACEHOLDER>,
          <&macro_release &hyp>;
    };
  };
};

