/ {
    behaviors {
        tds: tapdance_shift {
            compatible = "zmk,behavior-tap-dance";
            label = "TAPDANCE_SHIFT";
            #binding-cells = <0>;
            bindings = <&sk LEFT_SHIFT>, <&caps_word>, <&kp CAPSLOCK>;
        };
    };
};
