/ {
    hyp_mod: hyp_mod {
        compatible = "zmk,behavior-hold-tap";
        label = "HYPER_MOD";
        #binding-cells = <2>;
        bindings = <&hyp>, <&sk>;
        flavor = "tap-preferred";
        tapping-term-ms = <100>;
    };
};
