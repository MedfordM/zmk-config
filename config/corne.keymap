/*
 * Copyright (c) 2020 The ZMK Contributors
 *
 * SPDX-License-Identifier: MIT
 */

#include "behaviors.dtsi"
#include "dt-bindings/zmk/bt.h"
#include "dt-bindings/zmk/keys.h"
#include "dt-bindings/zmk/outputs.h"

#include "behaviors/config.dtsi"
#include "behaviors/homerow_mods.dtsi"
#include "behaviors/hyper_mod.dtsi"
#include "behaviors/general.dtsi"

#include "macros/hyper.dtsi"
#include "macros/windows.dtsi"

#define  DEFAULT 0
#define  GAMING  1
#define  SYMBOLS 2
#define  NUMBERS 3
#define  SYSTEM  4

#include "keymaps/physical_layout.dtsi"
#include "keymaps/default.dtsi"
#include "keymaps/gaming.dtsi"
#include "keymaps/symbols.dtsi"
#include "keymaps/numbers.dtsi"
#include "keymaps/system.dtsi"
#include "keymaps/conditions.dtsi"

