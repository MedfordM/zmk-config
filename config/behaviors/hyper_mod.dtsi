/ {
    hyp_mod: hyp_mod {
        compatible = "zmk,behavior-hold-tap";
        label = "HYPER_MOD";
        #binding-cells = <2>;
        bindings = <&hyp>, <&sk>;
        flavor = "balanced";
        tapping-term-ms = <175>;
    };
};
